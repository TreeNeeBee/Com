AUTOSAR XML (schema 00049)
package /ServiceInterfaces
  4 x service interface, all with minor-version=0:
    PerceptionService: major-version=1  # Sensor fusion and object detection service
      event ObjectList  # Detected objects in sensor field of view
      method GetObjectList  # Retrieve current object list
    PlanningService: major-version=1  # Motion planning and trajectory generation
      event Trajectory  # Planned vehicle trajectory
    VehicleControlService: major-version=2  # Vehicle control commands (ASIL-D safety level)
      method SetSteeringAngle  # Set target steering angle
      method SetThrottle  # Set throttle position
      method SetBrake  # Set brake pressure
    StateManagerService: major-version=1  # System state management and coordination
      event StateChanged  # System state transition notification
      method GetCurrentState
      method RequestStateChange
package /ServiceDeployments
  service-instance-deployments:
    4 x provided service instance, all with instance-id=0x0001:
      PerceptionInstance_01: service-interface=PerceptionService, sd-server-config=initial-offer-behavior={initial-delay-max-value=0.1, initial-delay-min-value=0.05, initial-repetitions-base-delay=0.01, initial-repetitions-max=3}, communication-connector={type=ICEORYX2, endpoint=/lap/perception/objects}
      PlanningInstance_01: service-interface=PlanningService, communication-connector={type=ICEORYX2, endpoint=/lap/planning/trajectory}
      ControlInstance_01: service-interface=VehicleControlService, safety-level=ASIL-D, communication-connector={type=ICEORYX2, endpoint=/lap/control/vehicle}
      StateManagerInstance_01: service-interface=StateManagerService, communication-connector={type=ICEORYX2, endpoint=/lap/system/state}
